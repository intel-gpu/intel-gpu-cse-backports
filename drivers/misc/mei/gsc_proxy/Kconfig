## drivers/misc/mei/gsc_proxy/Kconfig
```kconfig
# SPDX-License-Identifier: GPL-2.0
# Copyright (c) 2022, Intel Corporation. All rights reserved.
#
config INTEL_MEI_GSC_PROXY
	tristate "Intel GSC Proxy services of ME Interface"
	select INTEL_MEI_ME
	depends on DRM_I915
	help
	  MEI Support for GSC Proxy Services on Intel platforms.

	  Enables the ME FW services required for GSC Proxy support through
	  I915 display driver of Intel.
```
